## config/boards/tradepad.conf
```kconfig
CONFIG_ZMK_USB=y
CONFIG_ZMK_BLE=y
CONFIG_ZMK_SLEEP=y
CONFIG_ZMK_KEYMAP_LAYER_COUNT=5
```

## config/west.yml
```yaml
manifest:
  remotes:
    - name: zmkfirmware
      url-base: https://github.com/zmkfirmware
  projects:
    - name: zmk
      remote: zmkfirmware
      revision: 8c9f3e1a2b5d7e8f9a0b1c2d3e4f5a6b7c8d9e0f
      import: app/west.yml
  self:
    path: config
```
